/* Generated by CodeDescriptor 1.5.0.0907 */
/*
* Project Name      -> LED Kreisel
* Version           -> 1.0.0.0913
* Author            -> Knight Rider Effekt @ Workstadion.: QP-01-02
* Build Date        -> 13.09.2018 06:41:58
* Description       -> µC = ATtiny2313
*
*
*
*/



;##########################################################
;	Datensegment
;##########################################################
.dseg

;##########################################################
;	Kodesegment
;##########################################################
.cseg

;##########################################################
;	Definitionen
;##########################################################
				.equ F_CPU		= 8000000
				.equ F_DIV		= 1

				.def tmp		= r16
				.def eorReg		= r18
				.equ LED1_DDR	= DDRD
				.equ LED1_PORT	= PORTD

				.equ LED2_DDR	= DDRB
				.equ LED2_PORT	= PORTB

/*	setLed
*	para: 
*			@0 = PORTx
*			@1 = BITx
*			@2 = 0 = rücksetzen , 1 = setzen
*/
.macro      setLed
	sbi @0 , @1
.endmacro

.macro		clearLed
	cbi @0 , @1
.endmacro

;##########################################################
;	Sprungmarken
;##########################################################
.org 0x0000 rjmp main
.org 0x0004 rjmp timer0CmpInt
				
;##########################################################
;	Hardware initalisieren
;##########################################################
main:
				
				ldi tmp , low( RAMEND ) ; Addresse vom Ende des RAM´s ; 1 Takt
				out spl , tmp ; In das Stackpointer Register schreiben ; 1 Takt
				
				ldi tmp , 0xFF ; 1 Takt
				out LED1_DDR , tmp ; Ports als Ausgänge schalten ; 1 Takt
				out LED2_DDR , tmp ; .. ; 1 Takt

				ldi tmp , ( 1<<WGM12 | ( 1<<CS12 | 1<<CS10 ) ) ; Normal Mode -> CTC
				out TCCR1B , tmp ; Register beschreiben
				
				ldi tmp , 1<<OCIE1A ; Output Compare Match Enable
				out TIMSK , tmp ; Timer Interrupt Register beschreiben

				ldi tmp , 255 ; Output Compare Match Wert
				out OCR1AL , tmp ; .. Register beschreiben

				ldi tmp , 100 ; Output Compare Match Wert
				out OCR1AH , tmp ; .. Register beschreiben
				
				sei ; Interrupts freigeben
				
mainLoop:
				rjmp mainLoop

;##########################################################
;	Timer Interrupt - Compare Match A
;##########################################################
timer0CmpInt:
				eor eorReg, tmp
				andi eorReg , 0b00000001
				out PORTB , eorReg
				reti
;##########################################################
;	Delay Funktionen
;##########################################################
.def cntHigh	= r24
.def cntLow		= r25
.equ PRELOAD	= 10 ; 1 Millisekunde

delay1ms:
				ldi cntHigh , high( PRELOAD )
				ldi cntLow  , low ( PRELOAD )
delay1msLoop:		
				sbiw cntHigh : cntLow , 1
				brne delay1msLoop
				ret

delay10ms:
				ldi r17 , 10
delay10msLoop:
				rcall delay1ms
				dec r17
				brne delay10msLoop
				ret

delay100ms:
				ldi r18 , 10
delay100msLoop:
				rcall delay10ms
				dec r18
				brne delay100msLoop
				ret
	
delay1sek:
				ldi r19 , 10
delay1sekLoop:
				rcall delay100ms
				dec r19
				brne delay1sekLoop
				ret	
;##########################################################
;	Delay Funktionen Ende
;##########################################################				

				 